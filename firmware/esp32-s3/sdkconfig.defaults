## firmware/esp32-s3/sdkconfig.defaults
```kconfig
# Buddhas-Watch sdkconfig.defaults
# UeeKKoo ESP32-S3-Touch-AMOLED-2.06 board defaults
# Override with `idf.py menuconfig` as needed.

# ── Target ──────────────────────────────────────────────────────────────────
CONFIG_IDF_TARGET="esp32s3"

# ── Flash & PSRAM ────────────────────────────────────────────────────────────
CONFIG_ESPTOOLPY_FLASHSIZE_32MB=y
CONFIG_SPIRAM=y
CONFIG_SPIRAM_MODE_OCT=y
CONFIG_SPIRAM_SPEED_80M=y
CONFIG_SPIRAM_USE_MALLOC=y
CONFIG_SPIRAM_MALLOC_ALWAYSINTERNAL=16384

# ── CPU ──────────────────────────────────────────────────────────────────────
CONFIG_ESP32S3_DEFAULT_CPU_FREQ_240=y

# ── Wi-Fi ────────────────────────────────────────────────────────────────────
CONFIG_ESP_WIFI_STATIC_RX_BUFFER_NUM=16
CONFIG_ESP_WIFI_DYNAMIC_RX_BUFFER_NUM=32
CONFIG_ESP_WIFI_CSI_ENABLED=y
CONFIG_ESP_WIFI_AMPDU_TX_ENABLED=y
CONFIG_ESP_WIFI_AMPDU_RX_ENABLED=y

# ── BLE ──────────────────────────────────────────────────────────────────────
CONFIG_BT_ENABLED=y
CONFIG_BT_BLE_ENABLED=y
CONFIG_BTDM_CTRL_MODE_BLE_ONLY=y
CONFIG_BT_BLUEDROID_ENABLED=y
CONFIG_BT_GATTS_ENABLE=y
CONFIG_BT_GATT_MAX_SR_PROFILES=4
CONFIG_BT_BLE_SMP_ENABLE=y

# ── FreeRTOS ─────────────────────────────────────────────────────────────────
CONFIG_FREERTOS_HZ=1000
CONFIG_FREERTOS_UNICORE=n

# ── Stack sizes ───────────────────────────────────────────────────────────────
CONFIG_MAIN_TASK_STACK_SIZE=8192

# ── Logging ──────────────────────────────────────────────────────────────────
CONFIG_LOG_DEFAULT_LEVEL_INFO=y
CONFIG_LOG_MAXIMUM_LEVEL_DEBUG=y

# ── NVS ──────────────────────────────────────────────────────────────────────
CONFIG_NVS_ENCRYPTION=n

# ── FATFS (SD card) ───────────────────────────────────────────────────────────
CONFIG_FATFS_LFN_HEAP=y
CONFIG_FATFS_MAX_LFN=255
CONFIG_FATFS_CODEPAGE_850=y

# ── HTTP client ───────────────────────────────────────────────────────────────
CONFIG_ESP_HTTP_CLIENT_ENABLE_HTTPS=y
CONFIG_ESP_TLS_SERVER_SESSION_TICKETS=n
CONFIG_MBEDTLS_CERTIFICATE_BUNDLE=y

# ── App Store host (override in your local sdkconfig) ────────────────────────
# CONFIG_APP_STORE_HOST="https://your-store-host.example.com"

# ── Partition table ───────────────────────────────────────────────────────────
CONFIG_PARTITION_TABLE_CUSTOM=y
CONFIG_PARTITION_TABLE_CUSTOM_FILENAME="partitions.csv"
```
